## drivers/input/touchscreen/ft3418_i2c/Kconfig.rej
```kconfig
diff a/drivers/input/touchscreen/ft3418_i2c/Kconfig b/drivers/input/touchscreen/ft3418_i2c/Kconfig	(rejected hunks)
@@ -4,7 +4,6 @@
 
 config TOUCHSCREEN_FTS
 	bool "Focaltech Touchscreen"
-	depends on DRM
 	default n
 	help
 	  Say Y here if you have Focaltech touch panel.
@@ -12,5 +11,5 @@ config TOUCHSCREEN_FTS
       
 config TOUCHSCREEN_FTS_DIRECTORY
 	string "Focaltech ts directory name"
-	default "focaltech_touch"
+	default "ft3418_i2c"
 	depends on TOUCHSCREEN_FTS
```
